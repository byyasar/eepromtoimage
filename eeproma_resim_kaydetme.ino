/*

I2C device found at address 0x3C  !
I2C device found at address 0x57  !
I2C device found at address 0x68  !

*/


#include <Wire.h>  // Include the I2C Wire Library
#include <Adafruit_GFX.h>
#include <Adafruit_SSD1306.h>

#define SCREEN_WIDTH 128 // OLED display width, in pixels
#define SCREEN_HEIGHT 32 // OLED display height, in pixels
// Declaration for an SSD1306 display connected to I2C (SDA, SCL pins)
#define OLED_RESET     -1 // Reset pin # (or -1 if sharing Arduino reset pin)
Adafruit_SSD1306 display(SCREEN_WIDTH, SCREEN_HEIGHT, &Wire, OLED_RESET);

#define EEPROM_I2C_ADDRESS  0x57 // EEPROM I2C Address
#define DISPLAY_I2C_ADDRESS 0x3C // OLED I2C Address

#define IMG_HEIGHT   32
#define IMG_WIDTH    128
int page=1;
// Byte to hold data read from EEPROM
byte readVal = 0;
/*
const byte Image [512]PROGMEM = {
  0x00, 0x00, 0x00, 0x00, 0x00, 0x00, 0x00, 0x00, 0x00, 0x00, 0x00, 0x00, 0x00, 0x00, 0x00, 0x00, 
0x00, 0x00, 0x00, 0x00, 0x00, 0x00, 0x00, 0x00, 0x00, 0x00, 0x00, 0x00, 0x00, 0x00, 0x00, 0x00, 
0x02, 0x00, 0x00, 0x00, 0x80, 0x00, 0x00, 0x00, 0x00, 0x00, 0x00, 0x00, 0x00, 0x00, 0x00, 0x00, 
0x03, 0x00, 0x00, 0x01, 0x80, 0x00, 0x00, 0x00, 0x00, 0x00, 0x00, 0x00, 0x00, 0x00, 0x00, 0x00, 
0x03, 0x80, 0x00, 0x03, 0x80, 0x00, 0x00, 0x00, 0x00, 0x00, 0x00, 0x00, 0x00, 0x00, 0x00, 0x00, 
0x01, 0xd0, 0x00, 0x17, 0x00, 0x00, 0x00, 0x00, 0x00, 0x00, 0x00, 0x00, 0x00, 0x00, 0x00, 0x00, 
0x04, 0xfc, 0x00, 0x7e, 0x40, 0x00, 0x00, 0x00, 0x00, 0x00, 0x00, 0x00, 0x00, 0x00, 0x00, 0x00, 
0x03, 0xff, 0x83, 0xff, 0xe0, 0x00, 0x00, 0x00, 0x00, 0xc3, 0x80, 0x00, 0x00, 0x00, 0x00, 0x00, 
0x01, 0xff, 0xcf, 0xff, 0xfc, 0x00, 0x00, 0x00, 0x00, 0xc3, 0x80, 0x06, 0x00, 0x00, 0x00, 0x00, 
0x00, 0x7f, 0xff, 0xff, 0xfe, 0x00, 0x00, 0x00, 0x00, 0xc3, 0x80, 0x0e, 0x00, 0x00, 0x00, 0x00, 
0x00, 0x0f, 0xff, 0xfe, 0x07, 0x00, 0x00, 0x00, 0x00, 0x03, 0x80, 0x0e, 0x00, 0x00, 0x00, 0x00, 
0x00, 0x7f, 0xff, 0xfe, 0x07, 0x00, 0x00, 0x01, 0x80, 0x03, 0x80, 0x0e, 0x00, 0x20, 0x00, 0x40, 
0x00, 0x1d, 0xff, 0x0e, 0x03, 0x01, 0xf8, 0x0f, 0xf0, 0xc3, 0x83, 0x9f, 0xe3, 0xfc, 0x07, 0xf8, 
0x00, 0x18, 0xfe, 0x0e, 0x07, 0x03, 0xfe, 0x1e, 0x70, 0xc3, 0x87, 0x1f, 0xe3, 0xfe, 0x0f, 0xb8, 
0x00, 0x22, 0x7c, 0x8e, 0x0e, 0x06, 0x06, 0x18, 0x00, 0xc3, 0x8e, 0x0e, 0x00, 0x07, 0x0c, 0x00, 
0x00, 0x07, 0x6c, 0xcf, 0xfc, 0x0e, 0x07, 0x18, 0x00, 0xc3, 0x9c, 0x0e, 0x00, 0x03, 0x0c, 0x00, 
0x00, 0x07, 0x7e, 0xcf, 0xfe, 0x0c, 0x03, 0x18, 0x00, 0xc3, 0xb8, 0x0e, 0x00, 0x03, 0x0e, 0x00, 
0x00, 0x07, 0x5c, 0xce, 0x07, 0x0f, 0xff, 0x1f, 0x00, 0xc3, 0xf0, 0x0e, 0x01, 0xff, 0x0f, 0xc0, 
0x00, 0x06, 0x7c, 0xce, 0x03, 0x0f, 0xff, 0x0f, 0xe0, 0xc3, 0xe0, 0x0e, 0x03, 0xff, 0x03, 0xf0, 
0x00, 0x06, 0x38, 0xce, 0x03, 0x8c, 0x00, 0x00, 0xf0, 0xc3, 0xb8, 0x0e, 0x07, 0x03, 0x00, 0x78, 
0x00, 0x06, 0x6c, 0xce, 0x03, 0x8c, 0x00, 0x00, 0x30, 0xc3, 0x9c, 0x0e, 0x06, 0x03, 0x00, 0x1c, 
0x00, 0x06, 0x6c, 0xce, 0x03, 0x8e, 0x00, 0x00, 0x38, 0xc3, 0x8e, 0x06, 0x06, 0x07, 0x00, 0x1c, 
0x00, 0x0e, 0x38, 0xee, 0x07, 0x07, 0x00, 0x00, 0x30, 0xc3, 0x87, 0x06, 0x07, 0x07, 0x00, 0x1c, 
0x00, 0x0e, 0x00, 0xef, 0xfe, 0x03, 0xff, 0x3d, 0xf0, 0xc3, 0x83, 0x87, 0xe3, 0xff, 0x0e, 0xf8, 
0x00, 0x0e, 0x44, 0xef, 0xfc, 0x01, 0xfe, 0x1f, 0xe0, 0xc3, 0x81, 0xc3, 0xe1, 0xfb, 0x0f, 0xf0, 
0x00, 0x06, 0x7c, 0xc0, 0x00, 0x00, 0x00, 0x01, 0x80, 0x00, 0x00, 0x00, 0x00, 0x00, 0x00, 0xc0, 
0x00, 0x06, 0x34, 0xc0, 0x00, 0x00, 0x00, 0x00, 0xc0, 0x00, 0x00, 0x00, 0x00, 0x00, 0x00, 0x60, 
0x00, 0x02, 0x00, 0x80, 0x00, 0x00, 0x00, 0x00, 0xc0, 0x00, 0x00, 0x00, 0x00, 0x00, 0x00, 0x60, 
0x00, 0x00, 0x7c, 0x00, 0x00, 0x00, 0x00, 0x07, 0xc0, 0x00, 0x00, 0x00, 0x00, 0x00, 0x03, 0xe0, 
0x00, 0x00, 0x7c, 0x00, 0x00, 0x00, 0x00, 0x07, 0x00, 0x00, 0x00, 0x00, 0x00, 0x00, 0x01, 0x80, 
0x00, 0x00, 0x10, 0x00, 0x00, 0x00, 0x00, 0x00, 0x00, 0x00, 0x00, 0x00, 0x00, 0x00, 0x00, 0x00, 
0x00, 0x00, 0x00, 0x00, 0x00, 0x00, 0x00, 0x00, 0x00, 0x00, 0x00, 0x00, 0x00, 0x00, 0x00, 0x00
};*/

//const int maxaddress = sizeof(Image);

const int maxaddress =512;
byte ram_array [maxaddress];    // Array to hold image data in RAM (SRAM in Arduino Uno is 2 KB),

// OLED consume 1 KB and the other 1 KB will for image and all variables
// be sure that this image's size must not exceed 1 KB
void setup()
{
  // Connect to I2C bus as master
  Wire.begin();

  // Setup Serial Monitor
  Serial.begin(9600);
  // SSD1306_SWITCHCAPVCC = generate display voltage from 3.3V internally
  if (!display.begin(SSD1306_SWITCHCAPVCC, DISPLAY_I2C_ADDRESS)) {
    Serial.println(F("SSD1306 allocation failed")); // It will reserve in RAM 1KB=128x64 bits
    for (;;); // Don't proceed, loop forever
  }

  //memcpy_P(ram_array, Image, maxaddress);// copy the image from flash memory to RAM
  delay(50);

  display.clearDisplay();             // Clear the OLED-buffer
  display.setTextSize(1);             // Normal 1:1 pixel scale
  display.setTextColor(SSD1306_WHITE);        // Draw white text
  display.setCursor(0, 0);            // Start at top-left corner
  display.println(F("Hello, world!"));
  display.display();
  delay(500);

  test_eeprom(page); // Write image to EEPROM then read it out

 // testdrawpic(); // Display the read image from EEPROM on OLED
  // Invert and restore display, pausing in-between
  //display.invertDisplay(true);
  //delay(1000);
  //  display.invertDisplay(false);
  //  delay(1000);
}
void loop() {

   Serial.println(page%2);
  test_eeprom(page%2);
  delay(5000);
  page++;
}


void test_eeprom(int page) {
  // Print to Serial Monitor
 /* Serial.println("Start Writing...");

  display.clearDisplay();
  display.setTextSize(1);             // Normal 1:1 pixel scale
  display.setTextColor(SSD1306_WHITE);        // Draw white text
  display.setCursor(0, 0);            // Start at top-left corner
  display.println(F("Writing to EEPROM..."));
  display.display();

  for (int address = page*maxaddress; address < (page*maxaddress)+maxaddress; address++){
    writeEEPROM(address, ram_array[address-(page*maxaddress)], EEPROM_I2C_ADDRESS);
    Serial.print("ADDR = ");
    Serial.print(address);
    Serial.print("   data:");
    Serial.println(ram_array[address], HEX);
    delay(1);
  }

  // Print to Serial Monitor
  Serial.println("Writing Finished!");
  delay(2000);    // Delay 2 Seconds
*/
  // Print to Serial Monitor
  Serial.println("Begin Reading...");

  display.clearDisplay();
  display.setTextSize(1);             // Normal 1:1 pixel scale
  display.setTextColor(SSD1306_WHITE);        // Draw white text
  display.setCursor(0, 0);            // Start at top-left corner
  display.println(F("Reading from EEPROM.."));
  display.display();

  // Run until maximum address is reached
  for (int address = page*maxaddress; address < (page*maxaddress)+maxaddress; address++)
  {
    // Read value from EEPROM
    readVal = readEEPROM(address, EEPROM_I2C_ADDRESS);

    // Print to Serial Monitor
//   Serial.print("ADDR = ");
//   Serial.print(address);
//    Serial.print("   data:");
//   Serial.println(readVal, HEX);
   // Serial.print("ADDRsss = ");
  //  Serial.println(address-(page*maxaddress));
    ram_array[address-(page*maxaddress)] = readVal;
    delay(1);
  }

  // Print to Serial Monitor
  Serial.println("Reading Finished!");
  testdrawpic();
}

void testdrawpic(void) {
  display.clearDisplay();

  display.drawBitmap((display.width()  - IMG_WIDTH ) / 2, (display.height() - IMG_HEIGHT) / 2,
                     ram_array, IMG_WIDTH, IMG_HEIGHT, SSD1306_WHITE);
  display.display();
  //display.invertDisplay(true);
  delay(1000);
}
// Function to write to EEPROOM
void writeEEPROM(int address, byte val, int i2c_address)
{
  // Begin transmission to I2C EEPROM
  Wire.beginTransmission(i2c_address);

  // Send memory address as two 8-bit bytes
  Wire.write((int)(address >> 8));   // MSB
  Wire.write((int)(address & 0xFF)); // LSB

  // Send data to be stored
  Wire.write(val);

  // End the transmission
  Wire.endTransmission();

  // Add 5ms delay for EEPROM
  delay(50);
}

// Function to read from EEPROM
byte readEEPROM(int address, int i2c_address)
{
  // Define byte for received data
  byte rcvData = 0xFF;

  // Begin transmission to I2C EEPROM
  Wire.beginTransmission(i2c_address);

  // Send memory address as two 8-bit bytes
  Wire.write((int)(address >> 8));   // MSB
  Wire.write((int)(address & 0xFF)); // LSB

  // End the transmission
  Wire.endTransmission();

  // Request one byte of data at current memory address
  Wire.requestFrom(i2c_address, 1);

  // Read the data and assign to variable
  rcvData =  Wire.read();

  // Return the data as function output
  return rcvData;
}
